# file: v5_test_a.ioc
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ADC1.Channel-0\#ChannelRegularConversion=ADC_CHANNEL_2
ADC1.Channel-1\#ChannelRegularConversion=ADC_CHANNEL_13
ADC1.ClockPrescaler=ADC_CLOCK_SYNC_PCLK_DIV4
ADC1.ContinuousConvMode=ENABLE
ADC1.DMAContinuousRequests=ENABLE
ADC1.NbrOfConversion=2
ADC1.NbrOfConversionFlag=1
ADC1.Rank-0\#ChannelRegularConversion=1
ADC1.Rank-1\#ChannelRegularConversion=2
ADC1.SamplingTime-0\#ChannelRegularConversion=ADC_SAMPLETIME_84CYCLES
ADC1.SamplingTime-1\#ChannelRegularConversion=ADC_SAMPLETIME_84CYCLES
ADC1.ScanConvMode=ENABLE
ADC1.master=1
ADC3.Channel-0\#ChannelRegularConversion=ADC_CHANNEL_4
ADC3.Channel-1\#ChannelRegularConversion=ADC_CHANNEL_5
ADC3.Channel-10\#ChannelRegularConversion=ADC_CHANNEL_15
ADC3.Channel-2\#ChannelRegularConversion=ADC_CHANNEL_6
ADC3.Channel-3\#ChannelRegularConversion=ADC_CHANNEL_7
ADC3.Channel-4\#ChannelRegularConversion=ADC_CHANNEL_8
ADC3.Channel-5\#ChannelRegularConversion=ADC_CHANNEL_9
ADC3.Channel-6\#ChannelRegularConversion=ADC_CHANNEL_10
ADC3.Channel-7\#ChannelRegularConversion=ADC_CHANNEL_11
ADC3.Channel-8\#ChannelRegularConversion=ADC_CHANNEL_12
ADC3.Channel-9\#ChannelRegularConversion=ADC_CHANNEL_14
ADC3.ClockPrescaler=ADC_CLOCK_SYNC_PCLK_DIV4
ADC3.ContinuousConvMode=ENABLE
ADC3.DMAContinuousRequests=ENABLE
ADC3.NbrOfConversion=11
ADC3.NbrOfConversionFlag=1
ADC3.Rank-0\#ChannelRegularConversion=1
ADC3.Rank-1\#ChannelRegularConversion=2
ADC3.Rank-10\#ChannelRegularConversion=11
ADC3.Rank-2\#ChannelRegularConversion=3
ADC3.Rank-3\#ChannelRegularConversion=4
ADC3.Rank-4\#ChannelRegularConversion=5
ADC3.Rank-5\#ChannelRegularConversion=6
ADC3.Rank-6\#ChannelRegularConversion=7
ADC3.Rank-7\#ChannelRegularConversion=8
ADC3.Rank-8\#ChannelRegularConversion=9
ADC3.Rank-9\#ChannelRegularConversion=10
ADC3.SamplingTime-0\#ChannelRegularConversion=ADC_SAMPLETIME_3CYCLES
ADC3.SamplingTime-1\#ChannelRegularConversion=ADC_SAMPLETIME_3CYCLES
ADC3.SamplingTime-10\#ChannelRegularConversion=ADC_SAMPLETIME_3CYCLES
ADC3.SamplingTime-2\#ChannelRegularConversion=ADC_SAMPLETIME_3CYCLES
ADC3.SamplingTime-3\#ChannelRegularConversion=ADC_SAMPLETIME_3CYCLES
ADC3.SamplingTime-4\#ChannelRegularConversion=ADC_SAMPLETIME_3CYCLES
ADC3.SamplingTime-5\#ChannelRegularConversion=ADC_SAMPLETIME_3CYCLES
ADC3.SamplingTime-6\#ChannelRegularConversion=ADC_SAMPLETIME_3CYCLES
ADC3.SamplingTime-7\#ChannelRegularConversion=ADC_SAMPLETIME_3CYCLES
ADC3.SamplingTime-8\#ChannelRegularConversion=ADC_SAMPLETIME_3CYCLES
ADC3.SamplingTime-9\#ChannelRegularConversion=ADC_SAMPLETIME_3CYCLES
ADC3.ScanConvMode=ENABLE
CAN1.ABOM=ENABLE
CAN1.BS1=CAN_BS1_3TQ
CAN1.BS2=CAN_BS2_6TQ
CAN1.CalculateBaudRate=125000
CAN1.CalculateTimeBit=8000
CAN1.CalculateTimeQuantum=800.0
CAN1.NART=ENABLE
CAN1.Prescaler=24
CAN1.SJW=CAN_SJW_1TQ
CAN2.ABOM=ENABLE
CAN2.BS1=CAN_BS1_3TQ
CAN2.BS2=CAN_BS2_6TQ
CAN2.CalculateBaudRate=250000
CAN2.CalculateTimeBit=4000
CAN2.CalculateTimeQuantum=400.0
CAN2.NART=ENABLE
CAN2.Prescaler=12
Dma.ADC1.13.Direction=DMA_PERIPH_TO_MEMORY
Dma.ADC1.13.FIFOMode=DMA_FIFOMODE_DISABLE
Dma.ADC1.13.Instance=DMA2_Stream4
Dma.ADC1.13.MemDataAlignment=DMA_MDATAALIGN_HALFWORD
Dma.ADC1.13.MemInc=DMA_MINC_ENABLE
Dma.ADC1.13.Mode=DMA_CIRCULAR
Dma.ADC1.13.PeriphDataAlignment=DMA_PDATAALIGN_HALFWORD
Dma.ADC1.13.PeriphInc=DMA_PINC_DISABLE
Dma.ADC1.13.Priority=DMA_PRIORITY_LOW
Dma.ADC3.12.Direction=DMA_PERIPH_TO_MEMORY
Dma.ADC3.12.FIFOMode=DMA_FIFOMODE_DISABLE
Dma.ADC3.12.Instance=DMA2_Stream0
Dma.ADC3.12.MemDataAlignment=DMA_MDATAALIGN_HALFWORD
Dma.ADC3.12.MemInc=DMA_MINC_ENABLE
Dma.ADC3.12.Mode=DMA_CIRCULAR
Dma.ADC3.12.PeriphDataAlignment=DMA_PDATAALIGN_HALFWORD
Dma.ADC3.12.PeriphInc=DMA_PINC_DISABLE
Dma.ADC3.12.Priority=DMA_PRIORITY_LOW
Dma.Request0=UART4_RX
Dma.Request1=UART4_TX
Dma.Request10=USART2_RX
Dma.Request11=USART2_TX
Dma.Request12=ADC3
Dma.Request13=ADC1
Dma.Request2=USART3_RX
Dma.Request3=USART3_TX
Dma.Request4=USART6_RX
Dma.Request5=USART6_TX
Dma.Request6=USART1_RX
Dma.Request7=USART1_TX
Dma.Request8=UART5_RX
Dma.Request9=UART5_TX
Dma.UART4_RX.0.Direction=DMA_PERIPH_TO_MEMORY
Dma.UART4_RX.0.FIFOMode=DMA_FIFOMODE_DISABLE
Dma.UART4_RX.0.Instance=DMA1_Stream2
Dma.UART4_RX.0.MemDataAlignment=DMA_MDATAALIGN_BYTE
Dma.UART4_RX.0.MemInc=DMA_MINC_ENABLE
Dma.UART4_RX.0.Mode=DMA_NORMAL
Dma.UART4_RX.0.PeriphDataAlignment=DMA_PDATAALIGN_BYTE
Dma.UART4_RX.0.PeriphInc=DMA_PINC_DISABLE
Dma.UART4_RX.0.Priority=DMA_PRIORITY_LOW
Dma.UART4_TX.1.Direction=DMA_MEMORY_TO_PERIPH
Dma.UART4_TX.1.FIFOMode=DMA_FIFOMODE_DISABLE
Dma.UART4_TX.1.Instance=DMA1_Stream4
Dma.UART4_TX.1.MemDataAlignment=DMA_MDATAALIGN_BYTE
Dma.UART4_TX.1.MemInc=DMA_MINC_ENABLE
Dma.UART4_TX.1.Mode=DMA_NORMAL
Dma.UART4_TX.1.PeriphDataAlignment=DMA_PDATAALIGN_BYTE
Dma.UART4_TX.1.PeriphInc=DMA_PINC_DISABLE
Dma.UART4_TX.1.Priority=DMA_PRIORITY_LOW
Dma.UART5_RX.8.Direction=DMA_PERIPH_TO_MEMORY
Dma.UART5_RX.8.FIFOMode=DMA_FIFOMODE_DISABLE
Dma.UART5_RX.8.Instance=DMA1_Stream0
Dma.UART5_RX.8.MemDataAlignment=DMA_MDATAALIGN_BYTE
Dma.UART5_RX.8.MemInc=DMA_MINC_ENABLE
Dma.UART5_RX.8.Mode=DMA_NORMAL
Dma.UART5_RX.8.PeriphDataAlignment=DMA_PDATAALIGN_BYTE
Dma.UART5_RX.8.PeriphInc=DMA_PINC_DISABLE
Dma.UART5_RX.8.Priority=DMA_PRIORITY_LOW
Dma.UART5_TX.9.Direction=DMA_MEMORY_TO_PERIPH
Dma.UART5_TX.9.FIFOMode=DMA_FIFOMODE_DISABLE
Dma.UART5_TX.9.Instance=DMA1_Stream7
Dma.UART5_TX.9.MemDataAlignment=DMA_MDATAALIGN_BYTE
Dma.UART5_TX.9.MemInc=DMA_MINC_ENABLE
Dma.UART5_TX.9.Mode=DMA_NORMAL
Dma.UART5_TX.9.PeriphDataAlignment=DMA_PDATAALIGN_BYTE
Dma.UART5_TX.9.PeriphInc=DMA_PINC_DISABLE
Dma.UART5_TX.9.Priority=DMA_PRIORITY_LOW
Dma.USART1_RX.6.Direction=DMA_PERIPH_TO_MEMORY
Dma.USART1_RX.6.FIFOMode=DMA_FIFOMODE_DISABLE
Dma.USART1_RX.6.Instance=DMA2_Stream2
Dma.USART1_RX.6.MemDataAlignment=DMA_MDATAALIGN_BYTE
Dma.USART1_RX.6.MemInc=DMA_MINC_ENABLE
Dma.USART1_RX.6.Mode=DMA_NORMAL
Dma.USART1_RX.6.PeriphDataAlignment=DMA_PDATAALIGN_BYTE
Dma.USART1_RX.6.PeriphInc=DMA_PINC_DISABLE
Dma.USART1_RX.6.Priority=DMA_PRIORITY_LOW
Dma.USART1_TX.7.Direction=DMA_MEMORY_TO_PERIPH
Dma.USART1_TX.7.FIFOMode=DMA_FIFOMODE_DISABLE
Dma.USART1_TX.7.Instance=DMA2_Stream7
Dma.USART1_TX.7.MemDataAlignment=DMA_MDATAALIGN_BYTE
Dma.USART1_TX.7.MemInc=DMA_MINC_ENABLE
Dma.USART1_TX.7.Mode=DMA_NORMAL
Dma.USART1_TX.7.PeriphDataAlignment=DMA_PDATAALIGN_BYTE
Dma.USART1_TX.7.PeriphInc=DMA_PINC_DISABLE
Dma.USART1_TX.7.Priority=DMA_PRIORITY_LOW
Dma.USART2_RX.10.Direction=DMA_PERIPH_TO_MEMORY
Dma.USART2_RX.10.FIFOMode=DMA_FIFOMODE_DISABLE
Dma.USART2_RX.10.Instance=DMA1_Stream5
Dma.USART2_RX.10.MemDataAlignment=DMA_MDATAALIGN_BYTE
Dma.USART2_RX.10.MemInc=DMA_MINC_ENABLE
Dma.USART2_RX.10.Mode=DMA_NORMAL
Dma.USART2_RX.10.PeriphDataAlignment=DMA_PDATAALIGN_BYTE
Dma.USART2_RX.10.PeriphInc=DMA_PINC_DISABLE
Dma.USART2_RX.10.Priority=DMA_PRIORITY_LOW
Dma.USART2_TX.11.Direction=DMA_MEMORY_TO_PERIPH
Dma.USART2_TX.11.FIFOMode=DMA_FIFOMODE_DISABLE
Dma.USART2_TX.11.Instance=DMA1_Stream6
Dma.USART2_TX.11.MemDataAlignment=DMA_MDATAALIGN_BYTE
Dma.USART2_TX.11.MemInc=DMA_MINC_ENABLE
Dma.USART2_TX.11.Mode=DMA_NORMAL
Dma.USART2_TX.11.PeriphDataAlignment=DMA_PDATAALIGN_BYTE
Dma.USART2_TX.11.PeriphInc=DMA_PINC_DISABLE
Dma.USART2_TX.11.Priority=DMA_PRIORITY_LOW
Dma.USART3_RX.2.Direction=DMA_PERIPH_TO_MEMORY
Dma.USART3_RX.2.FIFOMode=DMA_FIFOMODE_DISABLE
Dma.USART3_RX.2.Instance=DMA1_Stream1
Dma.USART3_RX.2.MemDataAlignment=DMA_MDATAALIGN_BYTE
Dma.USART3_RX.2.MemInc=DMA_MINC_ENABLE
Dma.USART3_RX.2.Mode=DMA_NORMAL
Dma.USART3_RX.2.PeriphDataAlignment=DMA_PDATAALIGN_BYTE
Dma.USART3_RX.2.PeriphInc=DMA_PINC_DISABLE
Dma.USART3_RX.2.Priority=DMA_PRIORITY_LOW
Dma.USART3_TX.3.Direction=DMA_MEMORY_TO_PERIPH
Dma.USART3_TX.3.FIFOMode=DMA_FIFOMODE_DISABLE
Dma.USART3_TX.3.Instance=DMA1_Stream3
Dma.USART3_TX.3.MemDataAlignment=DMA_MDATAALIGN_BYTE
Dma.USART3_TX.3.MemInc=DMA_MINC_ENABLE
Dma.USART3_TX.3.Mode=DMA_NORMAL
Dma.USART3_TX.3.PeriphDataAlignment=DMA_PDATAALIGN_BYTE
Dma.USART3_TX.3.PeriphInc=DMA_PINC_DISABLE
Dma.USART3_TX.3.Priority=DMA_PRIORITY_LOW
Dma.USART6_RX.4.Direction=DMA_PERIPH_TO_MEMORY
Dma.USART6_RX.4.FIFOMode=DMA_FIFOMODE_DISABLE
Dma.USART6_RX.4.Instance=DMA2_Stream1
Dma.USART6_RX.4.MemDataAlignment=DMA_MDATAALIGN_BYTE
Dma.USART6_RX.4.MemInc=DMA_MINC_ENABLE
Dma.USART6_RX.4.Mode=DMA_NORMAL
Dma.USART6_RX.4.PeriphDataAlignment=DMA_PDATAALIGN_BYTE
Dma.USART6_RX.4.PeriphInc=DMA_PINC_DISABLE
Dma.USART6_RX.4.Priority=DMA_PRIORITY_LOW
Dma.USART6_TX.5.Direction=DMA_MEMORY_TO_PERIPH
Dma.USART6_TX.5.FIFOMode=DMA_FIFOMODE_DISABLE
Dma.USART6_TX.5.Instance=DMA2_Stream6
Dma.USART6_TX.5.MemDataAlignment=DMA_MDATAALIGN_BYTE
Dma.USART6_TX.5.MemInc=DMA_MINC_ENABLE
Dma.USART6_TX.5.Mode=DMA_NORMAL
Dma.USART6_TX.5.PeriphDataAlignment=DMA_PDATAALIGN_BYTE
Dma.USART6_TX.5.PeriphInc=DMA_PINC_DISABLE
Dma.USART6_TX.5.Priority=DMA_PRIORITY_LOW
FATFS._FS_LOCK=8
FATFS._FS_RPATH=2
FREERTOS.INCLUDE_uxTaskGetStackHighWaterMark=1
FREERTOS.Tasks01=defaultTask,0,128,StartDefaultTask,Default,NULL,Dynamic,NULL,NULL
FREERTOS.configCHECK_FOR_STACK_OVERFLOW=1
FREERTOS.configGENERATE_RUN_TIME_STATS=1
FREERTOS.configTOTAL_HEAP_SIZE=65536
FREERTOS.configUSE_COUNTING_SEMAPHORES=1
FREERTOS.configUSE_IDLE_HOOK=1
FREERTOS.configUSE_STATS_FORMATTING_FUNCTIONS=1
FREERTOS.configUSE_TICK_HOOK=1
IWDG.Prescaler=IWDG_PRESCALER_32
MBEDTLS.MBEDTLS_DEBUG_C=1
MBEDTLS.MBEDTLS_ERROR_C=1
MBEDTLS.MBEDTLS_KEY_EXCHANGE_ECDHE_RSA_ENABLED=1
MBEDTLS.MBEDTLS_MPI_MAX_SIZE=256
MBEDTLS.MBEDTLS_PKCS1_V15=1
MBEDTLS.MBEDTLS_PLATFORM_MEMORY=1
MBEDTLS.MBEDTLS_PLATFORM_PRINTF_MACRO_ENABLE=0
MBEDTLS.MBEDTLS_RSA_C=1
MBEDTLS.MBEDTLS_SSL_CIPHERSUITES=MBEDTLS_TLS_ECDHE_ECDSA_WITH_AES_256_GCM_SHA384,MBEDTLS_TLS_ECDHE_ECDSA_WITH_AES_128_GCM_SHA256,MBEDTLS_TLS_ECDHE_RSA_WITH_AES_128_GCM_SHA256
MBEDTLS.MBEDTLS_SSL_MAX_CONTENT_LEN=6144
MBEDTLS.MBEDTLS_SSL_MAX_CONTENT_LEN_ENABLE=1
Mcu.Family=STM32F4
Mcu.Name=STM32F407I(E-G)Tx
Mcu.Package=LQFP176
NVIC.CAN1_RX0_IRQn=true\:5\:0\:false\:false\:true\:true\:true\:true
NVIC.CAN1_TX_IRQn=true\:5\:0\:false\:false\:true\:true\:true\:true
NVIC.CAN2_RX1_IRQn=true\:5\:0\:false\:false\:true\:true\:true\:true
NVIC.CAN2_TX_IRQn=true\:5\:0\:false\:false\:true\:true\:true\:true
NVIC.DMA1_Stream0_IRQn=true\:5\:0\:false\:false\:true\:true\:false\:true
NVIC.DMA1_Stream1_IRQn=true\:5\:0\:false\:false\:true\:true\:false\:true
NVIC.DMA1_Stream2_IRQn=true\:5\:0\:false\:false\:true\:true\:false\:true
NVIC.DMA1_Stream3_IRQn=true\:5\:0\:false\:false\:true\:true\:false\:true
NVIC.DMA1_Stream4_IRQn=true\:5\:0\:false\:false\:true\:true\:false\:true
NVIC.DMA1_Stream5_IRQn=true\:5\:0\:false\:false\:true\:true\:false\:true
NVIC.DMA1_Stream6_IRQn=true\:5\:0\:false\:false\:true\:true\:false\:true
NVIC.DMA1_Stream7_IRQn=true\:5\:0\:false\:false\:true\:true\:false\:true
NVIC.DMA2_Stream0_IRQn=true\:5\:0\:false\:false\:true\:true\:false\:true
NVIC.DMA2_Stream1_IRQn=true\:5\:0\:false\:false\:true\:true\:false\:true
NVIC.DMA2_Stream2_IRQn=true\:5\:0\:false\:false\:true\:true\:false\:true
NVIC.DMA2_Stream4_IRQn=true\:5\:0\:false\:false\:true\:true\:false\:true
NVIC.DMA2_Stream6_IRQn=true\:5\:0\:false\:false\:true\:true\:false\:true
NVIC.DMA2_Stream7_IRQn=true\:5\:0\:false\:false\:true\:true\:false\:true
NVIC.EXTI9_5_IRQn=true\:5\:0\:false\:false\:true\:true\:true\:true
NVIC.OTG_FS_IRQn=true\:5\:0\:false\:false\:true\:true\:false\:true
NVIC.PriorityGroup=NVIC_PRIORITYGROUP_4
NVIC.TIM8_TRG_COM_TIM14_IRQn=true\:15\:0\:false\:false\:true\:false\:false\:true
NVIC.TimeBase=TIM8_TRG_COM_TIM14_IRQn
NVIC.TimeBaseIP=TIM14
NVIC.UART4_IRQn=true\:5\:0\:false\:false\:true\:true\:true\:true
NVIC.UART5_IRQn=true\:5\:0\:false\:false\:true\:true\:true\:true
NVIC.USART1_IRQn=true\:5\:0\:false\:false\:true\:true\:true\:true
NVIC.USART2_IRQn=true\:5\:0\:false\:false\:true\:true\:true\:true
NVIC.USART3_IRQn=true\:5\:0\:false\:false\:true\:true\:true\:true
NVIC.USART6_IRQn=true\:5\:0\:false\:false\:true\:true\:true\:true
PA0-WKUP.GPIO_Label=DC_METER1_TX
PA0-WKUP.Mode=Asynchronous
PA0-WKUP.Signal=UART4_TX
PA1.GPIO_Label=DC_METER1_RX
PA1.Mode=Asynchronous
PA1.Signal=UART4_RX
PA10.GPIO_Label=RFID_RX
PA10.Mode=Asynchronous
PA10.Signal=USART1_RX
PA11.Mode=Host_Only
PA11.Signal=USB_OTG_FS_DM
PA12.Mode=Host_Only
PA12.Signal=USB_OTG_FS_DP
PA13.Mode=Serial_Wire
PA13.Signal=SYS_JTMS-SWDIO
PA14.Mode=Serial_Wire
PA14.Signal=SYS_JTCK-SWCLK
PA15.GPIO_Label=PAR_EXT_RX1
PA15.Signal=GPIO_Input
PA2.GPIO_Label=CP1_VOLTAGE
PA2.Signal=ADCx_IN2
PA4.GPIO_Label=ETH_CS
PA4.Signal=GPIO_Output
PA5.GPIO_Label=ETH_SCK
PA5.Mode=Full_Duplex_Master
PA5.Signal=SPI1_SCK
PA6.GPIO_Label=ETH_MISO
PA6.Mode=Full_Duplex_Master
PA6.Signal=SPI1_MISO
PA7.GPIO_Label=ETH_MOSI
PA7.Mode=Full_Duplex_Master
PA7.Signal=SPI1_MOSI
PA8.GPIO_Label=DISCHARGE_RLY_PLUG2
PA8.Signal=GPIO_Output
PA9.GPIO_Label=RFID_TX
PA9.Mode=Asynchronous
PA9.Signal=USART1_TX
PB1.GPIO_Label=BRG_RLY_DRV
PB1.Signal=GPIO_Output
PB10.GPIO_Label=POWERDISTRIBUTION_1_BACK
PB10.Signal=GPIO_Input
PB11.GPIO_Label=POWERDISTRIBUTION_2_BACK
PB11.Signal=GPIO_Input
PB12.Mode=CAN_Activate
PB12.Signal=CAN2_RX
PB13.Mode=CAN_Activate
PB13.Signal=CAN2_TX
PB14.GPIO_Label=CHARGING_LED_LCLK2
PB14.Signal=GPIO_Output
PB15.GPIO_Label=CHARGING_LED_DS2
PB15.Signal=GPIO_Output
PB3.Mode=Full_Duplex_Master
PB3.Signal=SPI3_SCK
PB4.GPIO_Label=SPICAN_MISO
PB4.Mode=Full_Duplex_Master
PB4.Signal=SPI3_MISO
PB5.GPIO_Label=SPICAN_MOSI
PB5.Mode=Full_Duplex_Master
PB5.Signal=SPI3_MOSI
PB6.GPIO_Label=SPICAN_INT
PB6.Signal=GPXTI6
PB7.GPIO_Label=SPICAN_INT0
PB7.Signal=GPXTI7
PB8.GPIO_Label=SPICAN_INT1
PB8.GPIO_ModeDefaultEXTI=GPIO_MODE_IT_FALLING
PB8.Signal=GPXTI8
PB9.GPIO_Label=SPICAN_CLKO
PB9.Signal=GPIO_Input
PC0.GPIO_Label=CHARGER2_V
PC0.Signal=ADCx_IN10
PC1.GPIO_Label=BAT2_V
PC1.Signal=ADCx_IN11
PC10.GPIO_Label=PAR_EXT_RX2
PC10.Signal=GPIO_Input
PC11.GPIO_Label=PAR_EXT_RX3
PC11.Signal=GPIO_Input
PC12.GPIO_Label=EXTEND_TX
PC12.Mode=Asynchronous
PC12.Signal=UART5_TX
PC13-ANTI_TAMP.GPIO_Label=POWERDISTRIBUTION_5
PC13-ANTI_TAMP.Signal=GPIO_Output
PC14-OSC32_IN.Mode=LSE-External-Oscillator
PC14-OSC32_IN.Signal=RCC_OSC32_IN
PC15-OSC32_OUT.Mode=LSE-External-Oscillator
PC15-OSC32_OUT.Signal=RCC_OSC32_OUT
PC2.GPIO_Label=AMB_TEMP
PC2.Signal=ADCx_IN12
PC3.GPIO_Label=CP_VOLTAGE_PAR MODE
PC3.Signal=ADCx_IN13
PC6.GPIO_Label=LCD_TX
PC6.Mode=Asynchronous
PC6.Signal=USART6_TX
PC7.GPIO_Label=LCD_RX
PC7.Mode=Asynchronous
PC7.Signal=USART6_RX
PC9.GPIO_Label=DISCHARGE_RLY_PLUG1
PC9.Signal=GPIO_Output
PD0.GPIO_Label=CAN1_RX
PD0.Mode=CAN_Activate
PD0.Signal=CAN1_RX
PD1.GPIO_Label=CAN1_TX
PD1.Mode=CAN_Activate
PD1.Signal=CAN1_TX
PD10.GPIO_Label=POWERDISTRIBUTION_4_BACK
PD10.Signal=GPIO_Input
PD11.GPIO_Label=MAIN_RLY_PLUG1
PD11.Signal=GPIO_Output
PD12.GPIO_Label=BMSPOWER_PLUG1
PD12.Signal=GPIO_Output
PD13.GPIO_Label=PLUG1_LOCK_1
PD13.Signal=GPIO_Output
PD14.GPIO_Label=PLUG1_LOCK_2
PD14.Signal=GPIO_Output
PD15.GPIO_Label=K1_PLUG1
PD15.Signal=GPIO_Output
PD2.GPIO_Label=EXTEND_RX
PD2.Mode=Asynchronous
PD2.Signal=UART5_RX
PD3.GPIO_Label=CC1_PLUG2
PD3.Signal=GPIO_Input
PD4.GPIO_Label=CC1_PLUG1
PD4.Signal=GPIO_Input
PD5.GPIO_Label=RX_4G
PD5.Mode=Asynchronous
PD5.Signal=USART2_TX
PD6.Mode=Asynchronous
PD6.Signal=USART2_RX
PD8.GPIO_Label=DC_METER2_TX
PD8.Mode=Asynchronous
PD8.Signal=USART3_TX
PD9.GPIO_Label=DC_METER2_RX
PD9.Mode=Asynchronous
PD9.Signal=USART3_RX
PE0.GPIO_Label=FAN1_FAULT
PE0.Signal=GPIO_Input
PE1.GPIO_Label=FAN2_FAULT
PE1.Signal=GPIO_Input
PE10.GPIO_Label=MARQUEE2\#
PE10.Signal=GPIO_Output
PE11.GPIO_Label=ETH_RST
PE11.PinState=GPIO_PIN_SET
PE11.Signal=GPIO_Output
PE12.GPIO_Label=SYS_LED
PE12.Signal=GPIO_Output
PE13.GPIO_Label=DC_METER1_LED
PE13.Signal=GPIO_Output
PE14.GPIO_Label=DC_METER2_LED
PE14.Signal=GPIO_Output
PE15.GPIO_Label=LED_4G
PE15.Signal=GPIO_Output
PE2.GPIO_Label=FAN3_FAULT
PE2.Signal=GPIO_Input
PE3.GPIO_Label=FAN4_FAULT
PE3.Signal=GPIO_Input
PE4.GPIO_Label=FAN5_FAULT
PE4.Signal=GPIO_Input
PE5.GPIO_Label=LED_YELLOW_PLUG1
PE5.Signal=GPIO_Output
PE6.GPIO_Label=LED_YELLOW_PLUG2
PE6.Signal=GPIO_Output
PE7.GPIO_Label=DOOR1_OPEN
PE7.Signal=GPIO_Input
PE8.GPIO_Label=CP_RELAY
PE8.Signal=GPIO_Output
PE9.GPIO_Label=MARQUEE1\#
PE9.Signal=GPIO_Output
PF0.GPIO_Label=LED_RED_PLUG2
PF0.Signal=GPIO_Output
PF1.GPIO_Label=LED_GREEN_POWER1
PF1.Signal=GPIO_Output
PF10.GPIO_Label=INS_R_V_PLUG2
PF10.Mode=IN8
PF10.Signal=ADC3_IN8
PF11.GPIO_Label=BRG_RLY_DRV_BACK
PF11.Signal=GPIO_Input
PF12.GPIO_Label=SW_D0
PF12.Signal=GPIO_Input
PF13.GPIO_Label=SW_D1
PF13.Signal=GPIO_Input
PF14.GPIO_Label=SW_D2
PF14.Signal=GPIO_Input
PF15.GPIO_Label=SW_D3
PF15.Signal=GPIO_Input
PF2.GPIO_Label=EPO
PF2.Signal=GPIO_Input
PF3.GPIO_Label=TEMP+_PLUG1
PF3.Mode=IN9
PF3.Signal=ADC3_IN9
PF4.GPIO_Label=TEMP-_PLUG1
PF4.Mode=IN14
PF4.Signal=ADC3_IN14
PF5.GPIO_Label=BAT1_V
PF5.Mode=IN15
PF5.Signal=ADC3_IN15
PF6.GPIO_Label=TEMP-_PLUG2
PF6.Mode=IN4
PF6.Signal=ADC3_IN4
PF7.GPIO_Label=TEMP+_PLUG2
PF7.Mode=IN5
PF7.Signal=ADC3_IN5
PF8.GPIO_Label=CHARGER1_V
PF8.Mode=IN6
PF8.Signal=ADC3_IN6
PF9.GPIO_Label=INS_R_V_PLUG1
PF9.Mode=IN7
PF9.Signal=ADC3_IN7
PG0.GPIO_Label=SW_D4
PG0.Signal=GPIO_Input
PG1.GPIO_Label=FAN1_RLY_DRV
PG1.Signal=GPIO_Output
PG10.GPIO_Label=MAIN_RLY_PLUG2_BACK
PG10.Signal=GPIO_Input
PG11.GPIO_Label=BMSPOWER_PLUG2
PG11.Signal=GPIO_Output
PG12.GPIO_Label=PLUG2_LOCK_1
PG12.Signal=GPIO_Output
PG13.GPIO_Label=PLUG2_LOCK_2
PG13.Signal=GPIO_Output
PG14.GPIO_Label=PLUG2_LOCK_BACK
PG14.Signal=GPIO_Input
PG15.GPIO_Label=SPICAN_CS
PG15.Signal=GPIO_Output
PG2.GPIO_Label=POWERDISTRIBUTION_5_BACK
PG2.Signal=GPIO_Input
PG3.GPIO_Label=K3_PLUG1
PG3.Signal=GPIO_Output
PG4.GPIO_Label=MAIN_RLY_PLUG1_BACK
PG4.Signal=GPIO_Input
PG5.GPIO_Label=PLUG1_LOCK_BACK
PG5.Signal=GPIO_Input
PG6.GPIO_Label=K1_PLUG2
PG6.Signal=GPIO_Output
PG7.GPIO_Label=K3_PLUG2
PG7.Signal=GPIO_Output
PG8.GPIO_Label=CONTACTOR_DRV
PG8.Signal=GPIO_Output
PG9.GPIO_Label=MAIN_RLY_PLUG2
PG9.Signal=GPIO_Output
PH0-OSC_IN.Mode=HSE-External-Oscillator
PH0-OSC_IN.Signal=RCC_OSC_IN
PH1-OSC_OUT.Mode=HSE-External-Oscillator
PH1-OSC_OUT.Signal=RCC_OSC_OUT
PH10.GPIO_Label=CHARGING_LED_LCLK1
PH10.Signal=GPIO_Output
PH11.GPIO_Label=CHARGING_LED_DS1
PH11.Signal=GPIO_Output
PH12.GPIO_Label=CHARGING_LED_SCLK2
PH12.Signal=GPIO_Output
PH13.GPIO_Label=PAR_EXT_TX1
PH13.Signal=GPIO_Output
PH14.GPIO_Label=PAR_EXT_TX2
PH14.Signal=GPIO_Output
PH15.GPIO_Label=PAR_EXT_TX3
PH15.Signal=GPIO_Output
PH2.GPIO_Label=FUSE1_OPEN
PH2.Signal=GPIO_Input
PH3.GPIO_Label=FUSE2_OPEN
PH3.Signal=GPIO_Input
PH4.GPIO_Pu=GPIO_PULLUP
PH4.Mode=I2C
PH4.Signal=I2C2_SCL
PH5.GPIO_Pu=GPIO_PULLUP
PH5.Mode=I2C
PH5.Signal=I2C2_SDA
PH6.GPIO_Label=POWERDISTRIBUTION_3_BACK
PH6.Signal=GPIO_Input
PH7.GPIO_Label=EEP_SCL
PH7.GPIO_Pu=GPIO_PULLUP
PH7.Mode=I2C
PH7.Signal=I2C3_SCL
PH8.GPIO_Label=EEP_SDA
PH8.GPIO_Pu=GPIO_PULLUP
PH8.Mode=I2C
PH8.Signal=I2C3_SDA
PH9.GPIO_Label=CHARGING_LED_SCLK1
PH9.Signal=GPIO_Output
PI0.GPIO_Label=SPI_CS_1
PI0.Signal=GPIO_Output
PI1.GPIO_Label=SPI_SCK_1
PI1.Mode=Full_Duplex_Master
PI1.Signal=SPI2_SCK
PI10.GPIO_Label=VTRANS_2\#12V&24
PI10.Signal=GPIO_Output
PI11.GPIO_Label=LED_GREEN_POWER2
PI11.Signal=GPIO_Output
PI2.GPIO_Label=SPI_MISO_1
PI2.Mode=Full_Duplex_Master
PI2.Signal=SPI2_MISO
PI3.GPIO_Label=SPI_MOSI_1
PI3.Mode=Full_Duplex_Master
PI3.Signal=SPI2_MOSI
PI4.GPIO_Label=POWERDISTRIBUTION_1
PI4.Signal=GPIO_Output
PI5.GPIO_Label=POWERDISTRIBUTION_2
PI5.Signal=GPIO_Output
PI6.GPIO_Label=POWERDISTRIBUTION_3
PI6.Signal=GPIO_Output
PI7.GPIO_Label=POWERDISTRIBUTION_4
PI7.Signal=GPIO_Output
PI8-\ ANTI\ TAMP2.GPIO_Label=LED_RED_PLUG1
PI8-\ ANTI\ TAMP2.Signal=GPIO_Output
PI9.GPIO_Label=VTRANS_1\#12V&24
PI9.Signal=GPIO_Output
ProjectManager.HeapSize=0x14000
ProjectManager.StackSize=0x400
ProjectManager.TargetToolchain=Makefile
RCC.48MHZClocksFreq_Value=48000000
RCC.AHBFreq_Value=120000000
RCC.APB1CLKDivider=RCC_HCLK_DIV4
RCC.APB1Freq_Value=30000000
RCC.APB1TimFreq_Value=60000000
RCC.APB2CLKDivider=RCC_HCLK_DIV2
RCC.APB2Freq_Value=60000000
RCC.APB2TimFreq_Value=120000000
RCC.CortexFreq_Value=120000000
RCC.HCLKFreq_Value=120000000
RCC.HSE_VALUE=25000000
RCC.HSI_VALUE=16000000
RCC.PLLM=20
RCC.PLLQ=5
RCC.RCC_RTC_Clock_SourceVirtual=RCC_RTCCLKSOURCE_LSE
RCC.SYSCLKFreq_VALUE=120000000
RCC.SYSCLKSource=RCC_SYSCLKSOURCE_PLLCLK
RCC.VCOOutputFreq_Value=240000000
SH.ADCx_IN10.0=ADC3_IN10,IN10
SH.ADCx_IN11.0=ADC3_IN11,IN11
SH.ADCx_IN12.0=ADC3_IN12,IN12
SH.ADCx_IN13.0=ADC1_IN13,IN13
SH.ADCx_IN2.0=ADC1_IN2,IN2
SPI1.BaudRatePrescaler=SPI_BAUDRATEPRESCALER_8
SPI1.CalculateBaudRate=7.5 MBits/s
SPI1.Direction=SPI_DIRECTION_2LINES
SPI1.Mode=SPI_MODE_MASTER
SPI1.VirtualType=VM_MASTER
SPI2.BaudRatePrescaler=SPI_BAUDRATEPRESCALER_8
SPI2.CalculateBaudRate=3.75 MBits/s
SPI2.Direction=SPI_DIRECTION_2LINES
SPI2.Mode=SPI_MODE_MASTER
SPI2.VirtualType=VM_MASTER
SPI3.BaudRatePrescaler=SPI_BAUDRATEPRESCALER_8
SPI3.CalculateBaudRate=3.75 MBits/s
SPI3.Direction=SPI_DIRECTION_2LINES
SPI3.Mode=SPI_MODE_MASTER
SPI3.VirtualType=VM_MASTER
TIM1.AutoReloadPreload=TIM_AUTORELOAD_PRELOAD_ENABLE
TIM1.Period=1000-1
TIM1.Prescaler=120
UART4.BaudRate=9600
UART4.Parity=PARITY_EVEN
UART4.VirtualMode=Asynchronous
UART4.WordLength=WORDLENGTH_9B
UART5.VirtualMode=Asynchronous
USART1.BaudRate=9600
USART1.VirtualMode=VM_ASYNC
USART2.VirtualMode=VM_ASYNC
USART3.BaudRate=9600
USART3.Parity=PARITY_EVEN
USART3.VirtualMode=VM_ASYNC
USART3.WordLength=WORDLENGTH_9B
USART6.BaudRate=38400
USART6.VirtualMode=VM_ASYNC
USB_HOST.USBH_HandleTypeDef-MSC_FS=hUsbHostFS
USB_HOST.USBH_USE_OS-MSC_FS=0
USB_HOST.VirtualModeFS=Msc
USB_OTG_FS.VirtualMode=Host_Only
USB_OTG_FS.phy_itface=HCD_PHY_EMBEDDED
VP_FATFS_VS_USB.Mode=USB
VP_FREERTOS_VS_CMSIS_V1.Mode=CMSIS_V1
VP_IWDG_VS_IWDG.Mode=IWDG_Activate
VP_MBEDTLS_VS_MBEDTLS.Mode=Enabled
VP_RNG_VS_RNG.Mode=RNG_Activate
VP_RTC_VS_RTC_Activate.Mode=RTC_Enabled
VP_RTC_VS_RTC_Calendar.Mode=RTC_Calendar
VP_SYS_VS_tim14.Mode=TIM14
VP_TIM1_VS_ClockSourceINT.Mode=Internal
VP_USB_HOST_VS_USB_HOST_MSC_FS.Mode=MSC_FS
board=custom

// file: Src/main.c
/* USER CODE BEGIN Header */
/**
  ******************************************************************************
  * @file           : main.c
  * @brief          : Main program body
  ******************************************************************************
  * @attention
  *
  * Copyright (c) 2022 STMicroelectronics.
  * All rights reserved.
  *
  * This software is licensed under terms that can be found in the LICENSE file
  * in the root directory of this software component.
  * If no LICENSE file comes with this software, it is provided AS-IS.
  *
  ******************************************************************************
  */
/* USER CODE END Header */
#include "main.h"
#include "cmsis_os.h"
#include "adc.h"
#include "can.h"
#include "dma.h"
#include "fatfs.h"
#include "i2c.h"
#include "iwdg.h"
#include "mbedtls.h"
#include "rng.h"
#include "rtc.h"
#include "spi.h"
#include "tim.h"
#include "usart.h"
#include "usb_host.h"
#include "gpio.h"

/* USER CODE BEGIN Includes */

#include "early_sys_callback.h"
/* USER CODE END Includes */

void SystemClock_Config(void);
void MX_FREERTOS_Init(void);

int main(void)
{

  /* MCU Configuration--------------------------------------------------------*/

  /* Reset of all peripherals, Initializes the Flash interface and the Systick. */
  HAL_Init();

  /* Configure the system clock */
  SystemClock_Config();

  /* USER CODE BEGIN SysInit */

  early_sys_callback();

  /* USER CODE END SysInit */

  /* Initialize all configured peripherals */
  MX_GPIO_Init();
  MX_DMA_Init();
  MX_ADC3_Init();
  MX_CAN1_Init();
  MX_CAN2_Init();
  MX_I2C2_Init();
  MX_I2C3_Init();
  MX_SPI1_Init();
  MX_SPI2_Init();
  MX_SPI3_Init();
  MX_TIM1_Init();
  MX_UART4_Init();
  MX_UART5_Init();
  MX_USART1_UART_Init();
  MX_USART2_UART_Init();
  MX_USART3_UART_Init();
  MX_USART6_UART_Init();
  MX_FATFS_Init();
  MX_ADC1_Init();
  MX_RNG_Init();
  MX_MBEDTLS_Init();
  MX_RTC_Init();
  MX_IWDG_Init();

  /* Call init function for freertos objects (in freertos.c) */
  MX_FREERTOS_Init();
  /* Start scheduler */
  osKernelStart();

  /* We should never get here as control is now taken by the scheduler */
  /* Infinite loop */
  while (1)
  {

  }
}

void SystemClock_Config(void)
{
  RCC_OscInitTypeDef RCC_OscInitStruct = {0};
  RCC_ClkInitTypeDef RCC_ClkInitStruct = {0};

  /** Configure the main internal regulator output voltage
  */
  __HAL_RCC_PWR_CLK_ENABLE();
  __HAL_PWR_VOLTAGESCALING_CONFIG(PWR_REGULATOR_VOLTAGE_SCALE1);
  /** Initializes the RCC Oscillators according to the specified parameters
  * in the RCC_OscInitTypeDef structure.
  */
  RCC_OscInitStruct.OscillatorType = RCC_OSCILLATORTYPE_LSI|RCC_OSCILLATORTYPE_HSE
                              |RCC_OSCILLATORTYPE_LSE;
  RCC_OscInitStruct.HSEState = RCC_HSE_ON;
  RCC_OscInitStruct.LSEState = RCC_LSE_ON;
  RCC_OscInitStruct.LSIState = RCC_LSI_ON;
  RCC_OscInitStruct.PLL.PLLState = RCC_PLL_ON;
  RCC_OscInitStruct.PLL.PLLSource = RCC_PLLSOURCE_HSE;
  RCC_OscInitStruct.PLL.PLLM = 20;
  RCC_OscInitStruct.PLL.PLLN = 192;
  RCC_OscInitStruct.PLL.PLLP = RCC_PLLP_DIV2;
  RCC_OscInitStruct.PLL.PLLQ = 5;
  if (HAL_RCC_OscConfig(&RCC_OscInitStruct) != HAL_OK)
  {
    Error_Handler();
  }
  /** Initializes the CPU, AHB and APB buses clocks
  */
  RCC_ClkInitStruct.ClockType = RCC_CLOCKTYPE_HCLK|RCC_CLOCKTYPE_SYSCLK
                              |RCC_CLOCKTYPE_PCLK1|RCC_CLOCKTYPE_PCLK2;
  RCC_ClkInitStruct.SYSCLKSource = RCC_SYSCLKSOURCE_PLLCLK;
  RCC_ClkInitStruct.AHBCLKDivider = RCC_SYSCLK_DIV1;
  RCC_ClkInitStruct.APB1CLKDivider = RCC_HCLK_DIV4;
  RCC_ClkInitStruct.APB2CLKDivider = RCC_HCLK_DIV2;

  if (HAL_RCC_ClockConfig(&RCC_ClkInitStruct, FLASH_LATENCY_3) != HAL_OK)
  {
    Error_Handler();
  }
}

void HAL_TIM_PeriodElapsedCallback(TIM_HandleTypeDef *htim)
{
  if (htim->Instance == TIM14) {
    HAL_IncTick();
  }
}

void Error_Handler(void)
{
  __disable_irq();
  while (1)
  {
  }
}
